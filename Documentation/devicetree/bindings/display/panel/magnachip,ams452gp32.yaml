## Documentation/devicetree/bindings/display/panel/magnachip,ams452gp32.yaml
```yaml
# SPDX-License-Identifier: (GPL-2.0-only OR BSD-2-Clause)
%YAML 1.2
---
$id: http://devicetree.org/schemas/display/panel/magnachip,ams452gp32.yaml#
$schema: http://devicetree.org/meta-schemas/core.yaml#

title: Magnachip AMS452GP32 WVGA OLED panel

description: |
  Magnachip AMS452GP32 (SMD_AMS452GP32) 480x800 WVGA OLED panel.
  MIPI-DSI video mode, 2 lanes, RGB888. Used on Samsung Express Att (SGH-I437).

maintainers:
  - linux-arm-msm@vger.kernel.org

allOf:
  - $ref: panel-common.yaml#

properties:
  compatible:
    const: magnachip,ams452gp32

  reg:
    maxItems: 1

  port: true
  reset-gpios: true
  enable-gpios: true
  vddp-supply:
    description: panel power supply
  iovcc-supply:
    description: I/O voltage supply
  dcdc-en-gpios:
    maxItems: 1
    description: optional DCDC enable GPIO (e.g. PMIC GPIO)

  pinctrl-names: true
  pinctrl-0: true

required:
  - compatible
  - reg
  - port
  - reset-gpios

additionalProperties: false

examples:
  - |
    #include <dt-bindings/gpio/gpio.h>

    dsi {
        #address-cells = <1>;
        #size-cells = <0>;

        panel@0 {
            compatible = "magnachip,ams452gp32";
            reg = <0>;

            vddp-supply = <&pm8921_l17>;
            iovcc-supply = <&pm8921_lvs7>;
            reset-gpios = <&pm8921_gpio 43 GPIO_ACTIVE_LOW>;

            port {
                panel_in: endpoint {
                    remote-endpoint = <&dsi0_out>;
                };
            };
        };
    };
```

## Documentation/devicetree/bindings/display/panel/samsung,s6e3ha8.yaml
```yaml
# SPDX-License-Identifier: GPL-2.0-only OR BSD-2-Clause
%YAML 1.2
---
$id: http://devicetree.org/schemas/display/panel/samsung,s6e3ha8.yaml#
$schema: http://devicetree.org/meta-schemas/core.yaml#

title: Samsung S6E3HA8 AMOLED DSI panel

description: |
  The S6E3HA8 is a 1440x2960 AMOLED display controller from Samsung Mobile
  Display (SMD). The samsung,s6e3ha8 compatible describes the AMB577PX01
  panel module used by the Samsung Galaxy S9.

  The exact Samsung module or assembly part number used by Google Crosshatch
  is not present in the public downstream sources. The explicitly
  board-qualified samsung,s6e3ha8-crosshatch compatible is therefore used to
  keep its command-mode timings, power rails, and initialization sequence
  separate from the AMB577PX01 until that part number can be identified.

maintainers:
  - Dzmitry Sankouski <dsankouski@gmail.com>

allOf:
  - $ref: panel-common.yaml#

  - if:
      properties:
        compatible:
          const: samsung,s6e3ha8-crosshatch
    then:
      properties:
        vdd3-supply: false
        vddr-supply: false
      required:
        - te-gpios
        - vddi-supply
        - vci-supply
    else:
      properties:
        vddi-supply: false
      required:
        - vdd3-supply
        - vci-supply
        - vddr-supply

properties:
  compatible:
    enum:
      - samsung,s6e3ha8
      - samsung,s6e3ha8-crosshatch

  reg:
    maxItems: 1

  vdd3-supply:
    description: VDD regulator

  vddi-supply:
    description: 1.8 V interface supply

  vci-supply:
    description: VCI regulator

  vddr-supply:
    description: VDDR regulator

required:
  - compatible
  - reset-gpios

unevaluatedProperties: false

examples:
  - |
    #include <dt-bindings/gpio/gpio.h>

    dsi {
        #address-cells = <1>;
        #size-cells = <0>;

        panel@0 {
            compatible = "samsung,s6e3ha8";
            reg = <0>;
            vci-supply = <&s2dos05_ldo4>;
            vddr-supply = <&s2dos05_buck1>;
            vdd3-supply = <&s2dos05_ldo1>;
            te-gpios = <&tlmm 10 GPIO_ACTIVE_HIGH>;
            reset-gpios = <&tlmm 6 GPIO_ACTIVE_HIGH>;
            pinctrl-0 = <&sde_dsi_active &sde_te_active_sleep>;
            pinctrl-1 = <&sde_dsi_suspend &sde_te_active_sleep>;
            pinctrl-names = "default", "sleep";

            port {
                panel_in: endpoint {
                    remote-endpoint = <&mdss_dsi0_out>;
                };
            };
        };
    };

  - |
    #include <dt-bindings/gpio/gpio.h>

    dsi {
        #address-cells = <1>;
        #size-cells = <0>;

        panel@0 {
            compatible = "samsung,s6e3ha8-crosshatch";
            reg = <0>;
            vddi-supply = <&pm8998_l14>;
            vci-supply = <&pm8998_l28>;
            te-gpios = <&tlmm 12 GPIO_ACTIVE_HIGH>;
            reset-gpios = <&tlmm 6 GPIO_ACTIVE_LOW>;

            port {
                crosshatch_panel_in: endpoint {
                    remote-endpoint = <&mdss_dsi0_out>;
                };
            };
        };
    };

...
```

## Documentation/devicetree/bindings/misc/google,sargo-fingerprint.yaml
```yaml
# SPDX-License-Identifier: (GPL-2.0-only OR BSD-2-Clause)
%YAML 1.2
---
$id: http://devicetree.org/schemas/misc/google,sargo-fingerprint.yaml#
$schema: http://devicetree.org/meta-schemas/core.yaml#

title: Google Pixel 3a fingerprint electrical companion

maintainers:
  - Sam Day <me@samcday.com>

description: |
  Normal-world reset and interrupt wiring for the FPC-family sensor used by
  Google Sargo. The compatible identifies the board integration and Android
  driver family, not a measured silicon revision. The trusted application
  controls the sensor bus and performs biometric operations.

properties:
  compatible:
    items:
      - const: google,sargo-fingerprint
      - const: fpc,fpc1020

  firmware-name:
    const: fpctzappfingerprint

  reset-gpios:
    maxItems: 1

  irq-gpios:
    maxItems: 1

  wakeup-source: true

required:
  - compatible
  - firmware-name
  - reset-gpios
  - irq-gpios

additionalProperties: false
```

## Documentation/devicetree/bindings/power/supply/qcom,pm8921-charger.yaml
```yaml
# SPDX-License-Identifier: (GPL-2.0-only OR BSD-2-Clause)
%YAML 1.2
---
$id: http://devicetree.org/schemas/power/supply/qcom,pm8921-charger.yaml#
$schema: http://devicetree.org/meta-schemas/core.yaml#

title: Qualcomm PM8921 Battery Charger

maintainers:
  - Sebastian Reichel <sre@kernel.org>

description: |
  The PM8921/PM8917 PMIC charger is a single-cell battery charger exposed as a
  child of the PM8xxx SSBI PMIC.

allOf:
  - $ref: power-supply.yaml#

properties:
  compatible:
    oneOf:
      - const: qcom,pm8921-charger
      - items:
          - const: qcom,pm8917-charger
          - const: qcom,pm8921-charger

  reg:
    maxItems: 1

  interrupts:
    minItems: 5
    maxItems: 5

  interrupt-names:
    items:
      - const: usb-valid
      - const: charge-done
      - const: fast-charge
      - const: trickle-charge
      - const: battery-present

  qcom,fast-charge-current-limit:
    $ref: /schemas/types.yaml#/definitions/uint32
    minimum: 325000
    maximum: 2000000
    description: Maximum battery charge current in microamps.

  qcom,fast-charge-safe-current:
    $ref: /schemas/types.yaml#/definitions/uint32
    minimum: 225000
    maximum: 3375000
    description: Maximum safe battery charge current in microamps.

  qcom,fast-charge-high-threshold-voltage:
    $ref: /schemas/types.yaml#/definitions/uint32
    minimum: 3400000
    maximum: 4500000
    description: Target battery charge voltage in microvolts.

  qcom,fast-charge-safe-voltage:
    $ref: /schemas/types.yaml#/definitions/uint32
    minimum: 3400000
    maximum: 4500000
    description: Maximum safe battery charge voltage in microvolts.

  qcom,term-current:
    $ref: /schemas/types.yaml#/definitions/uint32
    minimum: 50000
    maximum: 200000
    description: End-of-charge termination current in microamps.

  usb-charge-current-limit:
    $ref: /schemas/types.yaml#/definitions/uint32
    minimum: 100000
    maximum: 1500000
    description: USB input current limit in microamps.

  monitored-battery: true

required:
  - compatible
  - reg
  - interrupts
  - interrupt-names

unevaluatedProperties: false

examples:
  - |
    #include <dt-bindings/interrupt-controller/irq.h>

    pmic {
      #address-cells = <1>;
      #size-cells = <0>;
      interrupt-controller;
      #interrupt-cells = <2>;

      charger@204 {
        compatible = "qcom,pm8921-charger";
        reg = <0x204>;
        interrupts = <15 IRQ_TYPE_EDGE_BOTH>,
                     <21 IRQ_TYPE_EDGE_RISING>,
                     <17 IRQ_TYPE_EDGE_BOTH>,
                     <16 IRQ_TYPE_EDGE_RISING>,
                     <13 IRQ_TYPE_EDGE_BOTH>;
        interrupt-names = "usb-valid", "charge-done", "fast-charge",
                          "trickle-charge", "battery-present";
        qcom,fast-charge-current-limit = <1500000>;
        qcom,fast-charge-safe-current = <2000000>;
        qcom,fast-charge-high-threshold-voltage = <4350000>;
        qcom,fast-charge-safe-voltage = <4350000>;
        qcom,term-current = <60000>;
        usb-charge-current-limit = <500000>;
      };
    };
```

## Documentation/devicetree/bindings/regulator/qcom,pm8917-direct-regulators.yaml
```yaml
# SPDX-License-Identifier: (GPL-2.0 OR BSD-2-Clause)
%YAML 1.2
---
$id: http://devicetree.org/schemas/regulator/qcom,pm8917-direct-regulators.yaml#
$schema: http://devicetree.org/meta-schemas/core.yaml#

title: Qualcomm PM8917 Direct Regulators

maintainers:
  - Sam Protsenko <semen.protsenko@linaro.org>

description:
  PM8917 regulators controlled directly through the PM8xxx SSBI register map.
  These are separate from regulators controlled by the Qualcomm RPM.

properties:
  compatible:
    const: qcom,pm8917-direct-regulators

patternProperties:
  "^l(30|33)$":
    type: object
    $ref: regulator.yaml#
    unevaluatedProperties: false

required:
  - compatible

additionalProperties: false

examples:
  - |
    regulators {
      compatible = "qcom,pm8917-direct-regulators";

      l30 {
        regulator-min-microvolt = <2800000>;
        regulator-max-microvolt = <2800000>;
        bias-pull-down;
      };
    };
...
```

## Documentation/devicetree/bindings/soc/qcom/qcom,eud.yaml
```yaml
# SPDX-License-Identifier: (GPL-2.0 OR BSD-2-Clause)
%YAML 1.2
---
$id: http://devicetree.org/schemas/soc/qcom/qcom,eud.yaml#
$schema: http://devicetree.org/meta-schemas/core.yaml#

title: Qualcomm Embedded USB Debugger

maintainers:
  - Souradeep Chowdhury <quic_schowdhu@quicinc.com>

description:
  This binding is used to describe the Qualcomm Embedded USB Debugger, which is
  mini USB-hub implemented on chip to support USB-based debug capabilities.

properties:
  compatible:
    oneOf:
      - items:
          - enum:
              - qcom,sc7280-eud
          - const: qcom,eud
      - items:
          - const: qcom,sdm845-eud
          - const: qcom,eud

  reg:
    minItems: 1
    items:
      - description: EUD Base Register Region
      - description: EUD Mode Manager Register

  interrupts:
    description: EUD interrupt
    maxItems: 1

  ports:
    $ref: /schemas/graph.yaml#/properties/ports
    description:
      These ports is to be attached to the endpoint of the DWC3 controller node
      and type C connector node. The controller has the "usb-role-switch"
      property.

    properties:
      port@0:
        $ref: /schemas/graph.yaml#/properties/port
        description: This port is to be attached to the DWC3 controller.

      port@1:
        $ref: /schemas/graph.yaml#/properties/port
        description: This port is to be attached to the type C connector.

required:
  - compatible
  - reg

allOf:
  - if:
      properties:
        compatible:
          contains:
            const: qcom,sc7280-eud
    then:
      properties:
        reg:
          minItems: 2
          maxItems: 2
      required:
        - ports
  - if:
      properties:
        compatible:
          contains:
            const: qcom,sdm845-eud
    then:
      properties:
        reg:
          maxItems: 1

additionalProperties: false

examples:
  - |
    eud@88e0000 {
        compatible = "qcom,sc7280-eud", "qcom,eud";
        reg = <0x88e0000 0x2000>,
              <0x88e2000 0x1000>;

        ports {
            #address-cells = <1>;
            #size-cells = <0>;
            port@0 {
                reg = <0>;
                eud_ep: endpoint {
                    remote-endpoint = <&usb2_role_switch>;
                };
            };

            port@1 {
                reg = <1>;
                eud_con: endpoint {
                    remote-endpoint = <&con_eud>;
                };
            };
        };
    };

  - |
    eud@88e0000 {
        compatible = "qcom,sdm845-eud", "qcom,eud";
        reg = <0x88e0000 0x2000>;
    };
```

## arch/arm/configs/mdm9607_defconfig
```kconfig
CONFIG_NO_HZ=y
CONFIG_HIGH_RES_TIMERS=y
CONFIG_PREEMPT=y
CONFIG_BLK_DEV_INITRD=y
CONFIG_PERF_EVENTS=y
CONFIG_ARCH_QCOM=y
CONFIG_SMP=y
CONFIG_VFP=y
CONFIG_NEON=y
CONFIG_MODULES=y
CONFIG_MODULE_UNLOAD=y
# CONFIG_CORE_DUMP_DEFAULT_ELF_HEADERS is not set
# CONFIG_COMPAT_BRK is not set
CONFIG_CMA=y
CONFIG_NET=y
CONFIG_PACKET=y
CONFIG_UNIX=y
CONFIG_INET=y
# CONFIG_IPV6 is not set
CONFIG_DEVTMPFS=y
CONFIG_DEVTMPFS_MOUNT=y
CONFIG_MTD=y
CONFIG_MTD_BLOCK=y
CONFIG_MTD_RAW_NAND=y
CONFIG_MTD_NAND_QCOM=y
CONFIG_BLK_DEV_LOOP=y
CONFIG_INPUT_EVDEV=y
# CONFIG_KEYBOARD_ATKBD is not set
CONFIG_KEYBOARD_GPIO=y
# CONFIG_MOUSE_PS2 is not set
# CONFIG_LEGACY_PTYS is not set
CONFIG_SERIAL_MSM=y
CONFIG_SERIAL_MSM_CONSOLE=y
CONFIG_HW_RANDOM=y
CONFIG_SPMI=y
CONFIG_PINCTRL_QCOM_SPMI_PMIC=y
CONFIG_POWER_RESET=y
CONFIG_POWER_RESET_MSM=y
CONFIG_THERMAL=y
CONFIG_QCOM_TSENS=y
CONFIG_WATCHDOG=y
CONFIG_QCOM_WDT=y
CONFIG_MFD_SPMI_PMIC=y
CONFIG_REGULATOR=y
CONFIG_REGULATOR_FIXED_VOLTAGE=y
CONFIG_REGULATOR_QCOM_SMD_RPM=y
CONFIG_REGULATOR_QCOM_SPMI=y
CONFIG_USB=y
CONFIG_USB_CHIPIDEA=y
CONFIG_USB_CHIPIDEA_UDC=y
CONFIG_USB_GADGET=y
CONFIG_USB_GADGET_VBUS_DRAW=500
CONFIG_USB_CONFIGFS=y
CONFIG_USB_CONFIGFS_ACM=y
CONFIG_USB_CONFIGFS_NCM=y
CONFIG_USB_CONFIGFS_ECM=y
CONFIG_USB_CONFIGFS_F_FS=y
CONFIG_MMC=y
CONFIG_MMC_SDHCI=y
CONFIG_MMC_SDHCI_PLTFM=y
CONFIG_MMC_SDHCI_MSM=y
CONFIG_RTC_CLASS=y
CONFIG_RTC_DRV_PM8XXX=y
CONFIG_DMADEVICES=y
CONFIG_QCOM_BAM_DMA=y
CONFIG_COMMON_CLK_QCOM=y
CONFIG_MDM_GCC_9607=y
CONFIG_HWSPINLOCK=y
CONFIG_HWSPINLOCK_QCOM=y
CONFIG_MAILBOX=y
CONFIG_RPMSG_QCOM_SMD=y
CONFIG_QCOM_RPMPD=y
CONFIG_EXTCON_USB_GPIO=y
CONFIG_PHY_QCOM_USB_HS_28NM=y
CONFIG_NVMEM_QCOM_QFPROM=y
CONFIG_EXT4_FS=y
CONFIG_VFAT_FS=y
CONFIG_TMPFS=y
CONFIG_PSTORE=y
CONFIG_PSTORE_CONSOLE=y
CONFIG_PSTORE_RAM=y
CONFIG_NLS_CODEPAGE_437=y
CONFIG_NLS_ASCII=y
CONFIG_NLS_ISO8859_1=y
CONFIG_NLS_UTF8=y
CONFIG_PRINTK_TIME=y
CONFIG_MAGIC_SYSRQ=y
```

## arch/arm64/Kconfig.debug
```kconfig
# SPDX-License-Identifier: GPL-2.0-only

config PID_IN_CONTEXTIDR
	bool "Write the current PID to the CONTEXTIDR register"
	help
	  Enabling this option causes the kernel to write the current PID to
	  the CONTEXTIDR register, at the expense of some additional
	  instructions during context switch. Say Y here only if you are
	  planning to use hardware trace tools with this kernel.

config DEBUG_EFI
	depends on EFI && DEBUG_INFO
	bool "UEFI debugging"
	help
	  Enable this option to include EFI specific debugging features into
	  the kernel that are only useful when using a debug build of the
	  UEFI firmware

config ARM64_RELOC_TEST
	depends on m
	tristate "Relocation testing module"

config J7XELTE_EARLY_BOOT_TRACE
	bool "Write j7xelte early boot breadcrumbs to persistent RAM"
	depends on ARCH_EXYNOS
	help
	  Write simple magic values to the j7xelte ramoops window during the
	  earliest arm64 boot path. This is a bring-up aid for debugging resets
	  before pstore/ramoops can initialize.

config J7XELTE_LATE_PANIC
	bool "Allow j7xelte late-init controlled panic"
	depends on ARCH_EXYNOS
	help
	  Add a bring-up-only late initcall that panics when the kernel command
	  line contains j7xelte.late_panic=1. This lets early board boot tests
	  verify panic reboot and pstore/ramoops after pstore has registered.

source "drivers/hwtracing/coresight/Kconfig"
```
